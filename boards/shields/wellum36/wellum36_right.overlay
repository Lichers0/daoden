#include "wellum36.dtsi"

&default_transform {
	col-offset = <6>;
};

&kscan0 {
	row-gpios
		= <&pro_micro 6  (GPIO_ACTIVE_HIGH | GPIO_PULL_DOWN)>  // Row 0
		, <&pro_micro 18 (GPIO_ACTIVE_HIGH | GPIO_PULL_DOWN)>  // Row 1
		, <&pro_micro 19 (GPIO_ACTIVE_HIGH | GPIO_PULL_DOWN)>  // Row 2
		, <&pro_micro 20 (GPIO_ACTIVE_HIGH | GPIO_PULL_DOWN)>  // Row 3
		;

	col-gpios
		= <&pro_micro 15 GPIO_ACTIVE_HIGH>  // Col 6
		, <&pro_micro 14 GPIO_ACTIVE_HIGH>  // Col 7
		, <&pro_micro 16 GPIO_ACTIVE_HIGH>  // Col 8
		, <&pro_micro 10 GPIO_ACTIVE_HIGH>  // Col 9
		, <&pro_micro 1  GPIO_ACTIVE_HIGH>  // Col 10
		, <&pro_micro 0  GPIO_ACTIVE_HIGH>  // Col 11
		;
};
